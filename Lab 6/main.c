//
// LCD_Bmp_Keypad: use 3x3 keypad to move bitmap on LCD
//
#include <stdio.h>
#include "NUC100Series.h"
#include "MCU_init.h"
#include "SYS_init.h"
#include "LCD.h"
#include "Scankey.h"
#include "Seven_Segment.h"

unsigned char stand_128x64[128*8] = {
	0x00,0x00,0x00,0x00,0x00,0x00,0x00,0x00,0x00,0x00,0x00,0x00,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0x00,
	0x00,0x00,0x00,0x00,0x00,0x00,0x00,0x00,0x00,0x00,0x00,0x00,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0x00,
	0x00,0x00,0x00,0x00,0x00,0x00,0x00,0x00,0x00,0x00,0x00,0x00,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0x00,
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	0x00,0x00,0x00,0x00,0x00,0x00,0x00,0x00,0x00,0x00,0x00,0x00,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0x00
};

unsigned char run1_128x64[128*8] = {
	0x00,0x00,0x00,0x00,0x00,0x00,0x00,0x00,0x00,0x00,0x00,0x00,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0x00,
	0x00,0x00,0x00,0x00,0x00,0x00,0x00,0x00,0x00,0x00,0x00,0x00,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0x00,
	0x00,0x00,0x00,0x00,0x00,0x00,0x00,0x00,0x00,0x00,0x00,0x00,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0x00,
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	0x00,0x00,0x00,0x00,0x00,0x00,0x00,0x00,0x00,0x00,0x00,0x00,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0x00
};

unsigned char run2_128x64[128*8] = {
	0x00,0x00,0x00,0x00,0x00,0x00,0x00,0x00,0x00,0x00,0x00,0x00,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0x00,
	0x00,0x00,0x00,0x00,0x00,0x00,0x00,0x00,0x00,0x00,0x00,0x00,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0x00,
	0x00,0x00,0x00,0x00,0x00,0x00,0x00,0x00,0x00,0x00,0x00,0x00,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0x00,
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	0x00,0x00,0x00,0x00,0x00,0x00,0x00,0x00,0x00,0x00,0x00,0x00,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0x00
};

void Buzz(int number)
{
	int i;
	GPIO_SetMode(PB, BIT11, GPIO_MODE_OUTPUT);
	for (i = 0; i < number; i++){
		PB11 = 0;                 // turn on Buzzer
		CLK_SysTickDelay(100000); // Delay
		PB11 = 1;                 // turn off Buzzer
		CLK_SysTickDelay(100000); // Delay
	}
}

void Init_GPIO(void)
{
	GPIO_SetMode(PA, BIT13, GPIO_MODE_OUTPUT);
	GPIO_SetMode(PA, BIT14, GPIO_MODE_OUTPUT);
	PA13=1;
	PA14=1;
}

void GREEN(void)
{
	int8_t i;
	PA12=1; PA13=0; PA14=1;   // set RGB LED to Green
	for(i = 9 ; i > 0 ; i--){
		// RGB LED
		PA12=1; PA13=0; PA14=1;
		// SevenSegment
		CloseSevenSegment();
		ShowSevenSegment(0, i);
		// LCD
		clear_LCD();
		if(i % 2 == 0) draw_LCD(run1_128x64);
		else draw_LCD(run2_128x64); 
		TIMER_Delay(TIMER0, 1000000);
	}
}

void RED(void)
{	
	int8_t j;
	PA12=1; PA13=1; PA14=0;   // set RGB LED to Green
	for(j = 5 ; j > 0 ; j--){
		// SevenSegment
		CloseSevenSegment();
		ShowSevenSegment(3, j);
		// LCD
		draw_LCD(stand_128x64);	
		TIMER_Delay(TIMER0, 1000000);
	}
}

void EINT1_IRQHandler(void)
{
	Buzz(1);
	RED();
  GPIO_CLR_INT_FLAG(PB, BIT15);	// Clear GPIO interrupt flag
}

void Init_EXTINT(void)
{
    // Configure EINT1 pin and enable interrupt by rising and falling edge trigger
    GPIO_SetMode(PB, BIT15, GPIO_MODE_INPUT);
    GPIO_EnableEINT1(PB, 15, GPIO_INT_RISING); // RISING, FALLING, BOTH_EDGE, HIGH, LOW
    NVIC_EnableIRQ(EINT1_IRQn);

    // Enable interrupt de-bounce function and select de-bounce sampling cycle time
    GPIO_SET_DEBOUNCE_TIME(GPIO_DBCLKSRC_LIRC, GPIO_DBCLKSEL_64);
    GPIO_ENABLE_DEBOUNCE(PB, BIT15);
}

int main(void)
{
	SYS_Init();
	Init_GPIO();
	Init_EXTINT();
	OpenSevenSegment();
	init_LCD();
	clear_LCD();

	while(1) {
		GREEN();
		RED();
	}
}
